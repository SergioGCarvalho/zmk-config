/*
 * Copyright (c) 2022 The ZMK Contributors
 *
 * SPDX-License-Identifier: MIT
 */

#include <behaviors.dtsi>
#include <dt-bindings/zmk/keys.h>
#include <dt-bindings/zmk/bt.h>
#include <dt-bindings/zmk/ext_power.h>
#include <dt-bindings/zmk/rgb.h>
#include <dt-bindings/zmk/outputs.h>

// #define HOST_OS 1



#include "zmk-helpers/helper.h"

// Source desired key-position labels
#include "zmk-helpers/key-labels/lily58.h"

#define DEF 0
#define LOW 1
#define RIS 2

//see https://github.com/joelspadin/zmk-locales to change local keys
// activate Linux-mode for helper script
#undef OS_UNICODE_LEAD
#undef OS_UNICODE_TRAIL
#define OS_UNICODE_LEAD &macro_tap &kp LS(LC(U))  // <- Linux compose sequence
#define OS_UNICODE_TRAIL &macro_tap &kp SPACE  // <- Space terminates unicode input on Linux

// use helper-script to define linux unicode macros, e.g.,
ZMK_UNICODE_PAIR(lin_c_cedilla,      N0, N0, E, N7,   N0, N0, C, N7)  // ç/Ç
ZMK_UNICODE_PAIR(lin_a_grave,        N0, N0, E, N0,   N0, N0, C, N0)  // à/À
ZMK_UNICODE_PAIR(lin_a_circumflex,   N0, N0, E, N2,   N0, N0, C, N2)  // â/Â
ZMK_UNICODE_PAIR(lin_c_cedilla,      N0, N0, E, N7,   N0, N0, C, N7)  // ç/Ç
ZMK_UNICODE_PAIR(lin_e_grave,        N0, N0, E, N8,   N0, N0, C, N8)  // è/È
ZMK_UNICODE_PAIR(lin_e_acute,        N0, N0, E, N9,   N0, N0, C, N9)  // é/É
ZMK_UNICODE_PAIR(lin_e_circumflex,   N0, N0, E, A,    N0, N0, C, A)   // ê/Ê
ZMK_UNICODE_PAIR(lin_o_circumflex,   N0, N0, F, N4,   N0, N0, D, N4)  // ô/Ô
ZMK_UNICODE_PAIR(lin_oa,             N0, N0,  F, N3,  N0, N0,  D, N3) // ó/Ó
ZMK_UNICODE_PAIR(lin_u_grave,        N0, N0, F, N9,   N0, N0, D, N9)  // ù/Ù
ZMK_UNICODE_PAIR(lin_u_circumflex,   N0, N0, F, B,    N0, N0, D, B)   // û/Û
ZMK_UNICODE_PAIR(lin_a_tilde,        N0, N0, E, N3,   N0, N0,  C, N3) // ã/Ã
ZMK_UNICODE_PAIR(lin_aa,             N0, N0,  E, N1,  N0, N0,  C, N1) // á/Á

// activate macOS-mode for helper script
#undef OS_UNICODE_LEAD
#undef OS_UNICODE_TRAIL
#define OS_UNICODE_LEAD &macro_press &kp LALT  // <- macOS compose sequence (must be activated in system preferences)
#define OS_UNICODE_TRAIL &macro_release &kp LALT  // <- Releasing Left-Alt terminates unicode input on macOns

ZMK_UNICODE_PAIR(mac_a_grave,        N0, N0, E, N0,   N0, N0, C, N0)  // à/À
ZMK_UNICODE_PAIR(mac_a_circumflex,   N0, N0, E, N2,   N0, N0, C, N2)  // â/Â
ZMK_UNICODE_PAIR(mac_c_cedilla,      N0, N0, E, N7,   N0, N0, C, N7)  // ç/Ç
ZMK_UNICODE_PAIR(mac_e_grave,        N0, N0, E, N8,   N0, N0, C, N8)  // è/È
ZMK_UNICODE_PAIR(mac_e_acute,        N0, N0, E, N9,   N0, N0, C, N9)  // é/É
ZMK_UNICODE_PAIR(mac_e_circumflex,   N0, N0, E, A,    N0, N0, C, A)   // ê/Ê
ZMK_UNICODE_PAIR(mac_o_circumflex,   N0, N0, F, N4,   N0, N0, D, N4)  // ô/Ô
ZMK_UNICODE_PAIR(mac_oa,             N0, N0,  F, N3,  N0, N0,  D, N3) // ó/Ó
ZMK_UNICODE_PAIR(mac_u_grave,        N0, N0, F, N9,   N0, N0, D, N9)  // ù/Ù
ZMK_UNICODE_PAIR(mac_u_circumflex,   N0, N0, F, B,    N0, N0, D, B)   // û/Û
ZMK_UNICODE_PAIR(mac_a_tilde,        N0, N0, E, N3,   N0, N0,  C, N3) // ã/Ã
ZMK_UNICODE_PAIR(mac_aa,             N0, N0,  E, N1,  N0, N0,  C, N1) // á/Á


ZMK_MACRO(cycle_hue,
    bindings = <&rgb_ug RGB_HUI>;
)

ZMK_MACRO(set_white,
    bindings = <&rgb_ug RGB_COLOR_HSB(0, 0, 1)>;
)

// ZMK_HOLD_TAP(cycle_white,
//     flavor           = "hold-preferred";
//     tapping-term-ms  = <200>;
//     bindings = <&cycle_hue , &set_white>;
// )


ZMK_TAP_DANCE(c_w_lf,
    tapping-term-ms = <300>;
    bindings = <&kp LSHFT>, <&caps_word>;
)

ZMK_TAP_DANCE(c_c_mac,
    tapping-term-ms = <300>;
    bindings = <&kp C>, <&mac_c_cedilla>;
)

ZMK_TAP_DANCE(c_c_combined,
    tapping-term-ms = <300>;
    bindings = <&kp C>, <&mac_c_cedilla>, <&lin_c_cedilla>;
)

// ZMK_MOD_MORPH(c_c_combined,
//     bindings = <&kp C>, <&mac_c_cedilla>;
//     mods =<MOD_LALT>;
// );

// ZMK_BEHAVIOR(tilde_behavior,
//     compatible = "zmk,behavior-tap";
//     label = "Tilde";
//     bindings = <&mac_a_tilde>;
// )

ZMK_MOD_MORPH(quest_N1,
    bindings = <&kp N1>, <&kp QUESTION>;
    mods = <MOD_LALT>;
)

// Dead key behavior (acts as a placeholder for tilde)
ZMK_BEHAVIOR(dead_tilde, macro,
    wait-ms = <500>;  // Waits for the next key input
    tap-ms = <5>;
    bindings = <&macro_tap &kp TILDE>;  // By default, acts like tilde (~)
)

// Morph to switch behavior based on modifiers
ZMK_MOD_MORPH(tilde_mod,
    bindings = <&kp N6>, <&dead_tilde>;
    mods = <MOD_LSFT>;
)

ZMK_MOD_MORPH(mix_N6,
    bindings = <&tilde_mod>, <&kp CARET>;
    mods = <MOD_LALT>;
)

// Combos to transform into ã and õ
// ZMK_COMBO(tilde_a_combo,
//     bindings = <&pt_a_tilde>;  // Outputs ã/Ã
//     key-positions = <N6 A>;
//     timeout-ms = <500>;
// )

// // Combo to allow tilde (~) when pressing space after Shift + N6
// ZMK_COMBO(tilde_space_combo,
//     bindings = <&kp TILDE>;
//     key-positions = <N6 SPACE>;
//     timeout-ms = <500>;
// )



// ZMK_COMBO(tilde_space_combo, &kp TILDE, RT1 LH0, DEF)

ZMK_COMBO(tilde_a_combo, &mac_a_tilde, RT1 LB4, DEF)

// ZMK_COMBO(, &mac_a_tilde, LF5 LB5 RB0, DEF)


ZMK_MOD_MORPH(lpl,
    bindings = <&kp LPAR>, <&kp LBRC>;
    mods = <MOD_LSFT>;
)

ZMK_MOD_MORPH(lpl_combined,
    bindings = <&lpl>, <&kp LBKT>;
    mods = <MOD_LALT>;
)

ZMK_MOD_MORPH(lpr,
    bindings = <&kp RPAR>, <&kp RBRC>;
    mods = <MOD_LSFT>;
)

ZMK_MOD_MORPH(lpr_combined,
    bindings = <&lpr>, <&kp RBKT>;
    mods = <MOD_LALT>;
)

ZMK_MOD_MORPH(c_w_lff,
    bindings = <&c_w_lf>, <&kp CAPS>;
    mods = <MOD_LALT>;
)

ZMK_MOD_MORPH(dotminor,
    bindings = <&kp DOT>, <&kp LT>;
    mods = <MOD_LSFT>;
)

ZMK_MOD_MORPH(dotbigger,
    bindings = <&dotminor>, <&kp GT>;
    mods = <MOD_LALT>;
)

ZMK_MOD_MORPH(comasemi,
    bindings = <&kp COMMA>, <&kp SEMICOLON>;
    mods = <MOD_LSFT>;
)

ZMK_MOD_MORPH(twodots,
    bindings = <&comasemi>, <&kp COLON>;
    mods = <MOD_LALT>;
)

ZMK_MOD_MORPH(graveapos,
    bindings = <&kp GRAVE>, <&kp APOS>;
    mods = <MOD_LSFT>;
)

ZMK_MOD_MORPH(gravedqt,
    bindings = <&graveapos>, <&kp DQT>;
    mods = <MOD_LALT>;
)

ZMK_MOD_MORPH(ninebar,
    bindings = <&kp N9>, <&kp PIPE>;
    mods = <MOD_LSFT>;
)

ZMK_MOD_MORPH(ninebarr,
    bindings = <&ninebar>, <&kp SLASH>;
    mods = <MOD_LALT>;
)

ZMK_MOD_MORPH(upplus,
    bindings = <&kp UP>, <&kp PLUS>;
    mods = <MOD_LALT>;
)

ZMK_MOD_MORPH(downminus,
    bindings = <&kp DOWN>, <&kp MINUS>;
    mods = <MOD_LALT>;
)

ZMK_MOD_MORPH(leftstar,
    bindings = <&kp LEFT>, <&kp STAR>;
    mods = <MOD_LALT>;
)

ZMK_MOD_MORPH(rightslash,
    bindings = <&kp RIGHT>, <&kp SLASH>;
    mods = <MOD_LALT>;
)

ZMK_MOD_MORPH(eightunder,
    bindings = <&kp N8>, <&kp UNDER>;
    mods = <MOD_LSFT>;
)

// ZMK_TAP_DANCE(lpl_combo,
//     tapping-term-ms = <300>;
//     bindings = <&lpl_shift>, <&lpl_alt>;
// )

// ZMK_TAP_DANCE(lpr_combo,
//     tapping-term-ms = <300>;
//     bindings = <&lpr_shift>, <&lpr_alt>;
// )

//ZMK_COMBO(caps_lock_combo, &kp CAPS, LH3 LF5)


ZMK_MACRO(lower_layer_macro,
    wait-ms = <100>;
    tap-ms = <5>;
    bindings = <&macro_press &mo 1>,
               <&macro_tap &rgb_ug RGB_COLOR_HSB(128,100,1)>,
               <&macro_release &mo 1>;
)

ZMK_MACRO(alt_m_combo,
    /* Delay between each behavior step (ms) */
    wait-ms = <0>;

    /* Delay for each tap’s press→release (ms) */
    tap-ms  = <10>;

    /* Press Alt, tap M, release Alt */
    bindings = <&macro_press   &kp LALT>, <&macro_tap     &kp M>, <&macro_release &kp LALT>;
)



ZMK_LAYER(default_layer,
    // ╭─────────────┬─────────────┬─────────────┬─────────────┬─────────────┬─────────────╮       ╭─────────────┬─────────────┬─────────────┬─────────────┬─────────────┬─────────────╮
         &kp ESC       &kp N0        &quest_N1        &kp N2        &kp N3        &kp N4             &kp N5        &mix_N6       &kp N7        &eightunder   &ninebarr     &dotbigger
    // ├─────────────┼─────────────┼─────────────┼─────────────┼─────────────┼─────────────┤       ├─────────────┼─────────────┼─────────────┼─────────────┼─────────────┼─────────────┤
         &kp TAB       &kp Q         &kp W         &kp F         &kp P         &kp B                 &kp J         &kp L         &kp U         &kp O         &kp Y         &twodots
    // ├─────────────┼─────────────┼─────────────┼─────────────┼─────────────┼─────────────┤       ├─────────────┼─────────────┼─────────────┼─────────────┼─────────────┼─────────────┤
         &kp LCTRL     &kp A         &kp R         &kp S         &kp T         &kp G                 &kp M         &kp N         &kp E         &kp I         &upplus        &key_repeat
    // ├─────────────┼─────────────┼─────────────┼─────────────┼─────────────┼─────────────┼───┬───┤───┬─────────┼─────────────┼─────────────┼─────────────┼─────────────┼─────────────┤
         &c_w_lff      &kp Z         &kp X         &kp C         &kp D         &kp V      &mo 1 &mo 2 &kp K        &kp H         &gravedqt     &leftstar     &downminus     &rightslash
    // ╰─────────────┴─────────────┴─────────────┴─────────────┴─────────────┴─────────────╯       ╰─────────────┴─────────────┴─────────────┴─────────────┴─────────────┴─────────────╯
                                     &kp LALT      &kp LGUI      &kp RET       &kp SPACE             &kp BSPC      &lpl_combined     &lpr_combined         &alt_m_combo
)

ZMK_LAYER(lower_layer,
    // ╭─────────────┬─────────────┬─────────────┬─────────────┬─────────────┬─────────────╮       ╭─────────────┬─────────────┬─────────────┬─────────────┬─────────────┬─────────────╮
         &out OUT_TOG  &bt BT_SEL 0  &bt BT_SEL 1  &bt BT_SEL 2  &bt BT_SEL 3  &bt BT_SEL 4          &kp K_VOL_DN  &kp K_VOL_UP  &kp K_MUTE    &kp C_PP      &kp C_PREV    &kp C_NEXT
    // ├─────────────┼─────────────┼─────────────┼─────────────┼─────────────┼─────────────┤       ├─────────────┼─────────────┼─────────────┼─────────────┼─────────────┼─────────────┤
         &kp F1        &kp F2        &kp F3        &kp F4        &kp F5        &kp F6                &kp F7        &kp F8        &kp F9        &kp F10       &kp F11       &kp F12
    // ├─────────────┼─────────────┼─────────────┼─────────────┼─────────────┼─────────────┤       ├─────────────┼─────────────┼─────────────┼─────────────┼─────────────┼─────────────┤
         &kp GRAVE     &kp EXCL      &kp AT        &kp HASH      &kp DOLLAR    &kp PRCNT             &kp CARET     &kp AMPS      &kp STAR      &kp LPAR      &kp RPAR      &key_repeat
    // ├─────────────┼─────────────┼─────────────┼─────────────┼─────────────┼─────────────┼───┬───┤───┬─────────┼─────────────┼─────────────┼─────────────┼─────────────┼─────────────┤
    &rgb_ug RGB_BRD &rgb_ug RGB_BRI &rgb_ug RGB_TOG &rgb_ug RGB_EFR &rgb_ug RGB_EFF &rgb_ug RGB_COLOR_HSB(0, 0, 1)    &trans &trans &kp MINUS   &kp PLUS      &kp LBRC      &kp RBRC      &kp PIPE      &trans
    // ╰─────────────┴─────────────┴─────────────┴─────────────┴─────────────┴─────────────╯       ╰─────────────┴─────────────┴─────────────┴─────────────┴─────────────┴─────────────╯
                                     &bt BT_CLR    &trans        &kp C_AL_LOCK &trans                &trans        &trans        &trans        &trans
)


ZMK_LAYER(raise_layer,
    // ╭─────────────┬─────────────┬─────────────┬─────────────┬─────────────┬─────────────╮       ╭─────────────┬─────────────┬─────────────┬─────────────┬─────────────┬─────────────╮
         &trans        &trans        &trans        &trans        &trans        &trans                &trans        &trans        &trans        &trans        &trans        &trans
    // ├─────────────┼─────────────┼─────────────┼─────────────┼─────────────┼─────────────┤       ├─────────────┼─────────────┼─────────────┼─────────────┼─────────────┼─────────────┤
         &kp GRAVE     &kp N1        &kp N2        &kp N3        &kp N4        &kp N5                &kp N6        &kp N7        &kp N8        &kp N9        &kp N0        &trans
    // ├─────────────┼─────────────┼─────────────┼─────────────┼─────────────┼─────────────┤       ├─────────────┼─────────────┼─────────────┼─────────────┼─────────────┼─────────────┤
         &kp F1        &kp F2        &kp F3        &kp F4        &kp F5        &kp F6                &trans        &kp LEFT      &kp DOWN      &kp UP        &kp RIGHT     &key_repeat
    // ├─────────────┼─────────────┼─────────────┼─────────────┼─────────────┼─────────────┼───┬───┤───┬─────────┼─────────────┼─────────────┼─────────────┼─────────────┼─────────────┤
         &kp F7        &kp F8        &kp F9        &kp F10       &kp F11       &kp F12   &trans &trans &kp KP_PLUS &kp MINUS     &kp EQUAL     &kp LBKT      &kp RBKT      &kp BSLH
    // ╰─────────────┴─────────────┴─────────────┴─────────────┴─────────────┴─────────────╯       ╰─────────────┴─────────────┴─────────────┴─────────────┴─────────────┴─────────────╯
                                     &trans        &trans        &trans        &trans                &studio_unlock &trans       &trans        &trans
)


 &led_strip {
     chain-length = <29>;
};

&nice_view_spi {
    cs-gpios = <&gpio0 8 GPIO_ACTIVE_HIGH>;
};
